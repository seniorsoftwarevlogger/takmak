## firmware/legacy/zmk-shield/Kconfig.defconfig
```kconfig
if SHIELD_TAKMAK_LEFT

config ZMK_KEYBOARD_NAME
	default "Takmak"

config ZMK_SPLIT_ROLE_CENTRAL
	default y

if ZMK_DISPLAY

config I2C
    default y

config SSD1306
    default y

endif # ZMK_DISPLAY

endif


if SHIELD_TAKMAK_LEFT || SHIELD_TAKMAK_RIGHT

config ZMK_SPLIT
	default y

endif
```

## firmware/legacy/zmk_new-shield/Kconfig.defconfig
```kconfig
if SHIELD_TAKMAK_LEFT
config ZMK_DISPLAY
    default y

config SPI
    default y

config DISPLAY
    default y

config LVGL
    default y


config ZMK_KEYBOARD_NAME
	default "Takmak 3.0 L"

config ZMK_SPLIT_ROLE_CENTRAL
	default y

endif # end SHIELD_TAKMAK_LEFT



if ZMK_DISPLAY

config I2C
    default y

config SSD1306
    default y

config LV_Z_VDB_SIZE
    default 64

config LV_DPI_DEF
    default 148

config LV_Z_BITS_PER_PIXEL
    default 1

choice LV_COLOR_DEPTH
    default LV_COLOR_DEPTH_1
endchoice

endif # ZMK_DISPLAY



if SHIELD_TAKMAK_RIGHT

config ZMK_KEYBOARD_NAME
	default "Takmak 3.0 R"

endif # end SHIELD_TAKMAK_RIGHT



if SHIELD_TAKMAK_LEFT || SHIELD_TAKMAK_RIGHT

config ZMK_SPLIT
	default y

endif # end both
```

## firmware/zmk-keyboard-takmak/boards/shields/takmak/Kconfig.defconfig
```kconfig
if SHIELD_TAKMAK_DONGLE

config ZMK_KEYBOARD_NAME
    default "Takmak 3.0"

endif # SHIELD_TAKMAK_DONGLE


if SHIELD_TAKMAK_RIGHT

config ZMK_KEYBOARD_NAME
    default "Takmak 3.0 R"

endif # end SHIELD_TAKMAK_RIGHT


if SHIELD_TAKMAK_LEFT

config ZMK_KEYBOARD_NAME
    default "Takmak 3.0 L"

if LVGL

config LV_Z_VDB_SIZE
    default 64

config LV_DPI_DEF
    default 148

config LV_Z_BITS_PER_PIXEL
    default 1

choice LV_COLOR_DEPTH
    default LV_COLOR_DEPTH_1
endchoice

endif # LVGL

if ZMK_DISPLAY

config I2C
    default y

config SSD1306
    default y

if ZMK_SPLIT_ROLE_CENTRAL

choice ZMK_DISPLAY_STATUS_SCREEN
    default ZMK_DISPLAY_STATUS_SCREEN_CUSTOM
endchoice

# Monochrome portrait screen fonts and allocation headroom.
config LV_USE_THEME_MONO
    default y

config LV_FONT_UNSCII_8
    default y

choice LV_FONT_DEFAULT
    default LV_FONT_DEFAULT_UNSCII_8
endchoice

choice ZMK_LV_FONT_DEFAULT_SMALL
    default ZMK_LV_FONT_DEFAULT_SMALL_UNSCII_8
endchoice

config LV_Z_MEM_POOL_SIZE
    default 8192

endif # ZMK_SPLIT_ROLE_CENTRAL

endif # ZMK_DISPLAY

endif # end SHIELD_TAKMAK_LEFT


if SHIELD_TAKMAK_LEFT || SHIELD_TAKMAK_RIGHT || SHIELD_TAKMAK_DONGLE

config ZMK_SPLIT
    default y

endif # end both
```

## firmware/zmk-takmak-tft/boards/shields/takmak_tft_dongle/Kconfig.shield
```kconfig
config SHIELD_TAKMAK_TFT_DONGLE
    def_bool $(shields_list_contains,takmak_tft_dongle)
```

## firmware/zmk-takmak-tft/boards/shields/takmak_tft_left_bench/Kconfig.defconfig
```kconfig
if SHIELD_TAKMAK_TFT_LEFT_BENCH
config ZMK_KEYBOARD_NAME
    default "Takmak TFT Left"
config ZMK_SPLIT
    default y
config ZMK_SPLIT_ROLE_CENTRAL
    default y
endif
```

## firmware/zmk-takmak-tft/boards/shields/takmak_tft_left_bench/Kconfig.shield
```kconfig
config SHIELD_TAKMAK_TFT_LEFT_BENCH
    def_bool $(shields_list_contains,takmak_tft_left_bench)
```

## firmware/zmk-takmak-tft/dts/bindings/behaviors/takmak,behavior-tft-mode.yaml
```yaml
description: Cycle the three Takmak portrait display pages
compatible: "takmak,behavior-tft-mode"
include: zero_param.yaml
```

## firmware/zmk-takmak-tft/manifest/west.yml
```yaml
manifest:
  group-filter:
  - -babblesim
  - -optional
  projects:
  - name: zmk
    url: https://github.com/zmkfirmware/zmk
    revision: ccf20a1f5c1534a197d32279abbe0eaf651099d8
    west-commands: scripts/west-commands.yml
  - name: zephyr
    url: https://github.com/zmkfirmware/zephyr
    revision: dacab4875df72109b96cc8977547a0dc04875bcd
    clone-depth: 1
    west-commands: scripts/west-commands.yml
  - name: nanopb
    url: https://github.com/zmkfirmware/nanopb
    revision: 8c60555d6277a0360c876bd85d491fc4fb0cd74a
    path: modules/lib/nanopb
  - name: zmk-studio-messages
    url: https://github.com/zmkfirmware/zmk-studio-messages
    revision: 6cb4c283e76209d59c45fbcb218800cd19e9339d
    path: modules/msgs/zmk-studio-messages
  - name: cmsis
    url: https://github.com/zephyrproject-rtos/cmsis
    revision: 5a00331455dd74e31e80efa383a489faea0590e3
    path: modules/hal/cmsis
    groups:
    - hal
  - name: hal_nordic
    url: https://github.com/zephyrproject-rtos/hal_nordic
    revision: 884c4d61746bc35fbd379c169fc87ddb56c6461d
    path: modules/hal/nordic
    groups:
    - hal
  - name: lvgl
    url: https://github.com/zephyrproject-rtos/lvgl
    revision: 8a6a2d1d29d17d1e4bdc94c243c146a39d635fdd
    path: modules/lib/gui/lvgl
  - name: segger
    url: https://github.com/zephyrproject-rtos/segger
    revision: 9d0191285956cef43daf411edc2f1a7788346def
    path: modules/debug/segger
    groups:
    - debug
  - name: tinycrypt
    url: https://github.com/zephyrproject-rtos/tinycrypt
    revision: 3e9a49d2672ec01435ffbf0d788db6d95ef28de0
    path: modules/crypto/tinycrypt
    groups:
    - crypto
  self:
    path: manifest
```
