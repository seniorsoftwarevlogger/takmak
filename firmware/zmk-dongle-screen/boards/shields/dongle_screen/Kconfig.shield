## firmware/zmk-keyboard-takmak/Kconfig
```kconfig
config ZMK_SPLIT_BLE_PREF_WEAK_BOND
    bool "Enable split peripheral weak bond"
```

## firmware/zmk-keyboard-takmak/boards/shields/takmak/Kconfig.shield
```kconfig
# Copyright (c) 2020 Pete Johanson
# SPDX-License-Identifier: MIT

config SHIELD_TAKMAK_LEFT
	def_bool $(shields_list_contains,takmak_left)

config SHIELD_TAKMAK_RIGHT
	def_bool $(shields_list_contains,takmak_right)

config SHIELD_TAKMAK_DONGLE
	def_bool $(shields_list_contains,takmak_dongle)
```

## firmware/zmk-keyboard-takmak/config/west.yml
```yaml
manifest:
  remotes:
    - name: zmkfirmware
      url-base: https://github.com/zmkfirmware
    - name: seniorsoftwarevlogger
      url-base: https://github.com/seniorsoftwarevlogger
  projects:
    - name: zmk
      remote: zmkfirmware
      revision: ccf20a1f5c1534a197d32279abbe0eaf651099d8
      import: app/west.yml
    - name: zmk-dongle-screen
      remote: seniorsoftwarevlogger
      revision: 2aecc3291141b85d2256ffb0a14325500a979165
  self:
    path: config
```
