/*
 * Copyright (c) 2020 Pete Johanson
 *
 * SPDX-License-Identifier: MIT
 */

#include "takmak.dtsi"

&kscan0 {
  row-gpios
			= <&pro_micro 2  (GPIO_ACTIVE_HIGH | GPIO_PULL_DOWN)>
			, <&pro_micro 3  (GPIO_ACTIVE_HIGH | GPIO_PULL_DOWN)>
			, <&pro_micro 14 (GPIO_ACTIVE_HIGH | GPIO_PULL_DOWN)>
			, <&pro_micro 16 (GPIO_ACTIVE_HIGH | GPIO_PULL_DOWN)>
			, <&pro_micro 10 (GPIO_ACTIVE_HIGH | GPIO_PULL_DOWN)>
			;
      
	col-gpios
		= <&pro_micro 5  GPIO_ACTIVE_HIGH>
		, <&pro_micro 4  GPIO_ACTIVE_HIGH>
		, <&pro_micro 6  GPIO_ACTIVE_HIGH>
		, <&pro_micro 20 GPIO_ACTIVE_HIGH>
		, <&pro_micro 19 GPIO_ACTIVE_HIGH>
		, <&pro_micro 18 GPIO_ACTIVE_HIGH>
		, <&pro_micro 15 GPIO_ACTIVE_HIGH>
		;
};

// #define MATRIX_ROW_PINS { D1, D0, B3, B2, B6  }
// #define MATRIX_COL_PINS { B5, B1, F7, F6, F5, D7, D4, C6}